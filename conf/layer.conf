## conf/layer.conf
```bitbake
BBPATH .= ":${LAYERDIR}"

BBFILES += "\
    ${LAYERDIR}/recipes-*/*/*.bb \
    ${LAYERDIR}/recipes-*/*/*.bbappend \
"

BBFILE_COLLECTIONS += "meta-luarocks-extra"
BBFILE_PATTERN_meta-luarocks-extra = "^${LAYERDIR}/"
BBFILE_PRIORITY_meta-luarocks-extra = "7"

LAYERDEPENDS_meta-luarocks-extra += "luarocks"

LAYERSERIES_COMPAT_meta-luarocks-extra = "scarthgap"
```
